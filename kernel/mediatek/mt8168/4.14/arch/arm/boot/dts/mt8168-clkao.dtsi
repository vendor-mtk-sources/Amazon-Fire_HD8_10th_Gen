// SPDX-License-Identifier: GPL-2.0
/*
 * Copyright (c) 2019 MediaTek Inc.
 */

&clkao {
	status = "okay";

	bring-up {
		compatible = "mediatek,clk-bring-up";
		clocks =
			<&apmixedsys CLK_APMIXED_ARMPLL>,
			<&apmixedsys CLK_APMIXED_MAINPLL>,
			<&clk26m>,
			<&clk26m>,
			<&clk26m>,
			<&clk26m>,
			<&clk26m>,
			<&clk26m>,
			<&clk26m>,
			<&clk26m>,
			<&clk26m>,
			<&clk26m>,
			<&clk26m>,
			<&clk26m>,
			<&clk26m>,
			<&clk26m>,
			<&clk26m>,
			<&clk26m>,
			<&clk26m>,
			<&clk26m>,
			<&clk26m>,
			<&clk26m>,
			<&topckgen CLK_TOP_ETH_SEL>,
			<&clk26m>,
			<&clk26m>,
			<&clk26m>,
			<&clk26m>,
			<&clk26m>,
			<&clk26m>,
			<&clk26m>,
			<&clk26m>,
			<&clk26m>,
			<&clk26m>,
			<&clk26m>,
			<&clk26m>,
			<&infracfg CLK_IFR_PMIC_AP>,
			<&infracfg CLK_IFR_PMIC_MD>,
			<&infracfg CLK_IFR_PMIC_CONN>,
			<&clk26m>,
			<&clk26m>,
			<&clk26m>,
			<&clk26m>,
			<&clk26m>,
			<&clk26m>,
			<&clk26m>,
			<&clk26m>,
			<&clk26m>,
			<&clk26m>,
			<&clk26m>,
			<&clk26m>,
			<&clk26m>,
			<&clk26m>,
			<&clk26m>,
			<&clk26m>,
			<&clk26m>,
			<&infracfg CLK_IFR_DVFSRC>,
			<&clk26m>,
			<&clk26m>,
			<&clk26m>,
			<&clk26m>,
			<&clk26m>,
			<&clk26m>,
			<&clk26m>,
			<&clk26m>,
			<&clk26m>,
			<&clk26m>,
			<&clk26m>,
			<&clk26m>,
			<&clk26m>,
			<&clk26m>,
			<&clk26m>,
			<&clk26m>,
			<&clk26m>,
			<&clk26m>,
			<&clk26m>,
			<&infracfg CLK_IFR_PWRAP_TMR>,
			<&infracfg CLK_IFR_PWRAP_SPI>,
			<&infracfg CLK_IFR_PWRAP_SYS>,
			<&clk26m>,
			<&clk26m>,
			<&clk26m>,
			<&clk26m>,
			<&clk26m>,
			<&clk26m>,
			<&infracfg CLK_IFR_NIC_AXI>,
			<&infracfg CLK_IFR_NIC_SLV_AXI>,
			<&clk26m>,
			<&clk26m>,
			<&clk26m>,
			<&clk26m>,
			<&clk26m>,
			<&clk26m>,
			<&clk26m>,
			<&clk26m>,
			<&clk26m>,
			<&clk26m>,
			<&clk26m>,
			<&clk26m>,
			<&clk26m>,
			<&clk26m>,
			<&clk26m>,
			<&clk26m>,
			<&clk26m>,
			<&clk26m>,
			<&clk26m>,
			<&clk26m>,
			<&clk26m>,
			<&clk26m>,
			<&clk26m>,
			<&clk26m>,
			<&clk26m>,
			<&clk26m>,
			<&clk26m>,
			<&clk26m>,
			<&clk26m>,
			<&clk26m>,
			<&clk26m>,
			<&clk26m>,
			<&clk26m>,
			<&clk26m>,
			<&clk26m>,
			<&clk26m>,
			<&clk26m>,
			<&clk26m>,
			<&clk26m>,
			<&clk26m>,
			<&clk26m>,
			<&clk26m>,
			<&clk26m>,
			<&clk26m>,
			<&clk26m>,
			<&clk26m>,
			<&clk26m>,
			<&clk26m>;
	};
};
